#include "AjoloteSprite.h"
#include "DisplayTFT.h"

extern DisplayTFT tft;

// ═══════════════════════════════════════════════════════════════════════════
//  BITMAP DEL AJOLOTE CON LENTES · 96x80 píxeles monochrome
//  · 80 filas × 12 bytes = 960 bytes
//  · Mascota oficial del firmware
//  · Compartido entre SplashScreen, About y Screensaver
// ═══════════════════════════════════════════════════════════════════════════
const uint8_t AJOLOTE_BMP[AJOLOTE_BYTES] PROGMEM = {
    0x00, 0x00, 0x00, 0x00, 0x00, 0x00, 0x00, 0x00, 0x00, 0x00, 0x00, 0x00,
    0x00, 0x00, 0x00, 0x00, 0x00, 0x00, 0x00, 0x00, 0x00, 0x00, 0x00, 0x00,
    0x00, 0x00, 0x00, 0x00, 0x00, 0x00, 0x00, 0x00, 0x00, 0x00, 0x00, 0x00,
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    0x00, 0x00, 0x00, 0x00, 0x00, 0x00, 0x00, 0x00, 0x00, 0x00, 0x00, 0x00,
};

// ═══════════════════════════════════════════════════════════════════════════
//  HELPERS DE DIBUJO
// ═══════════════════════════════════════════════════════════════════════════

void drawAjoloteRow(int x0, int y0, int row, uint16_t color) {
    int bytesPerRow = AJOLOTE_WIDTH / 8;
    for (int byteIdx = 0; byteIdx < bytesPerRow; byteIdx++) {
        uint8_t bits = pgm_read_byte(
            &AJOLOTE_BMP[row * bytesPerRow + byteIdx]);
        if (bits == 0) continue;
        for (int bit = 0; bit < 8; bit++) {
            if (bits & (0x80 >> bit)) {
                tft.drawPixel(x0 + byteIdx * 8 + bit, y0 + row, color);
            }
        }
    }
}

void drawAjoloteFull(int x0, int y0, uint16_t color) {
    for (int r = 0; r < AJOLOTE_HEIGHT; r++) {
        drawAjoloteRow(x0, y0, r, color);
    }
}

void drawAjoloteScaled(int x0, int y0, uint16_t color, int scale) {
    if (scale <= 1) { drawAjoloteFull(x0, y0, color); return; }

    int bytesPerRow = AJOLOTE_WIDTH / 8;
    for (int r = 0; r < AJOLOTE_HEIGHT; r++) {
        for (int byteIdx = 0; byteIdx < bytesPerRow; byteIdx++) {
            uint8_t bits = pgm_read_byte(
                &AJOLOTE_BMP[r * bytesPerRow + byteIdx]);
            if (bits == 0) continue;
            for (int bit = 0; bit < 8; bit++) {
                if (bits & (0x80 >> bit)) {
                    int px = x0 + (byteIdx * 8 + bit) * scale;
                    int py = y0 + r * scale;
                    tft.fillRect(px, py, scale, scale, color);
                }
            }
        }
    }
}

// Dibuja el ajolote a la mitad (48x40): solo lee filas pares y bits pares
void drawAjoloteHalf(int x0, int y0, uint16_t color) {
    int bytesPerRow = AJOLOTE_WIDTH / 8;
    for (int r = 0; r < AJOLOTE_HEIGHT; r += 2) {
        int outY = y0 + r / 2;
        for (int byteIdx = 0; byteIdx < bytesPerRow; byteIdx++) {
            uint8_t bits = pgm_read_byte(
                &AJOLOTE_BMP[r * bytesPerRow + byteIdx]);
            if (bits == 0) continue;
            for (int bit = 0; bit < 8; bit += 2) {
                if (bits & (0x80 >> bit)) {
                    int outX = x0 + (byteIdx * 8 + bit) / 2;
                    tft.drawPixel(outX, outY, color);
                }
            }
        }
    }
}
