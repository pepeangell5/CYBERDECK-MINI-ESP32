#include "Icons.h"
#include "DisplayTFT.h"

extern DisplayTFT tft;

// ═══════════════════════════════════════════════════════════════════════════
//  BITMAPS 64x64 MONOCROMO
//  Cada fila = 8 bytes (64 bits). MSB = pixel más a la izquierda.
//  1 = pixel encendido, 0 = transparente.
//  Cada ícono = 64 filas × 8 bytes = 512 bytes exactos.
// ═══════════════════════════════════════════════════════════════════════════

// ── ICON_WIFI · router con ondas hacia arriba ─────────────────────────────
static const uint8_t ICON_WIFI_BMP[ICON_BYTES] PROGMEM = {
    0,0,0,0,0,0,0,0,
    0,0,0,0,0,0,0,0,
    0,0,0,0x01,0xFF,0x80,0,0,
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    0,0,0,0,0,0,0,0,
};

// ── ICON_RADIO · torre con ondas concéntricas ─────────────────────────────
static const uint8_t ICON_RADIO_BMP[ICON_BYTES] PROGMEM = {
    0,0,0,0,0,0,0,0,
    0,0,0,0,0,0,0,0,
    0,0,0,0,0,0,0,0,
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    0,0,0,0,0,0,0,0,
};

// ── ICON_BLUETOOTH · símbolo BT runa ──────────────────────────────────────
static const uint8_t ICON_BT_BMP[ICON_BYTES] PROGMEM = {
    0,0,0,0,0,0,0,0,
    0,0,0,0,0,0,0,0,
    0,0,0,0,0,0,0,0,
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    0,0,0,0,0,0,0,0,
};

// ── ICON_MONITOR · osciloscopio con onda ──────────────────────────────────
static const uint8_t ICON_MONITOR_BMP[ICON_BYTES] PROGMEM = {
    0,0,0,0,0,0,0,0,
    0,0,0,0,0,0,0,0,
    0,0,0,0,0,0,0,0,
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    0,0,0,0,0,0,0,0,
};

// ── ICON_SYSTEM · engrane/tuerca ──────────────────────────────────────────
static const uint8_t ICON_SYSTEM_BMP[ICON_BYTES] PROGMEM = {
    0,0,0,0,0,0,0,0,
    0,0,0,0,0,0,0,0,
    0,0,0,0,0,0,0,0,
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    0,0,0,0,0,0,0,0,
};

// ═══════════════════════════════════════════════════════════════════════════
//  TABLA DE PUNTEROS · acceso rápido por IconID
// ═══════════════════════════════════════════════════════════════════════════
static const uint8_t* const ICON_TABLE[ICON_COUNT] = {
    ICON_WIFI_BMP,
    ICON_RADIO_BMP,
    ICON_BT_BMP,
    ICON_MONITOR_BMP,
    ICON_SYSTEM_BMP
};

// ═══════════════════════════════════════════════════════════════════════════
//  drawIcon · dibuja el bitmap centrado en (cx, cy)
//  Los pixels "encendidos" se pintan con `color`, los apagados son transparentes
// ═══════════════════════════════════════════════════════════════════════════
void drawIcon(int cx, int cy, IconID id, uint16_t color,
              int yMin, int yMax) {
    if (id < 0 || id >= ICON_COUNT) return;

    const uint8_t* bmp = ICON_TABLE[id];
    int x0 = cx - ICON_SIZE / 2;
    int y0 = cy - ICON_SIZE / 2;

    for (int row = 0; row < ICON_SIZE; row++) {
        int py = y0 + row;
        // ── Clipping vertical: descartar filas fuera del área permitida ──
        if (py < yMin || py > yMax) continue;

        for (int byteIdx = 0; byteIdx < ICON_SIZE / 8; byteIdx++) {
            uint8_t bits = pgm_read_byte(&bmp[row * (ICON_SIZE / 8) + byteIdx]);
            if (bits == 0) continue;

            for (int bit = 0; bit < 8; bit++) {
                if (bits & (0x80 >> bit)) {
                    tft.drawPixel(x0 + byteIdx * 8 + bit, py, color);
                }
            }
        }
    }
}
